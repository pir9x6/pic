//&&&&&&&&&&&&&&&&&&&&&&&&&&&&&&&&&&&&&&&&&&&&&&&&&&&&&&&&&&&&&
//&&&           Titre : Afficheur LCD Graphique 128x64      &&&
//&&&           Auteur : Pierre Blaché                      &&&
//&&&           Date :  Decembre 2007 / Janvier 2008        &&&
//&&&&&&&&&&&&&&&&&&&&&&&&&&&&&&&&&&&&&&&&&&&&&&&&&&&&&&&&&&&&&

#include <p18CXXX.h>
//#include "font5x7.c"
#pragma config WDT = OFF        // Watchdog OFF
#pragma config OSC = HS         // Quartz 20MHz
#pragma config LVP = OFF        // Low Power Prog OFF

#define LCD_E   PORTCbits.RC7
#define LCD_RW  PORTCbits.RC6
#define LCD_RS  PORTCbits.RC5
#define LCD_CS1 PORTCbits.RC4
#define LCD_CS2 PORTCbits.RC3
#define LCD_RST PORTCbits.RC2


const char display[512]={
0x00, 0x00, 0x00, 0x00, 0x00, 0x00, 0x00, 0x00, 0x00, 0x00, 0x00, 0x00, 0x00, 0x80, 0x80, 0xC0, //LCD page 0//
0xE0, 0xE0, 0x70, 0x70, 0x38, 0x38, 0x38, 0x1C, 0x1C, 0x1C, 0x1C, 0x0E, 0x0E, 0x0E, 0x0E, 0x0E,
0x0E, 0x0E, 0x0E, 0x0E, 0x0E, 0x1C, 0x1C, 0x1C, 0x1C, 0x38, 0x38, 0x38, 0x70, 0x70, 0xE0, 0xE0,
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0x03, 0x01, 0x01, 0x00, 0x00, 0x00, 0x00, 0x00, 0x00, 0x00, 0x00, 0x00, 0x00, 0x00, 0x00, 0x00
};



unsigned char x,y,cs;
unsigned int Pntr;
//&&&&&&&&&&&&&&&&&&&&&&&&&&&&&&&&&&&&&&&&&&&&&&&&&&&&&&&&&&&&&
//-------------------------- Delay ----------------------------
//&&&&&&&&&&&&&&&&&&&&&&&&&&&&&&&&&&&&&&&&&&&&&&&&&&&&&&&&&&&&&
void Delay_ms (unsigned int Cnt)
    {
    unsigned int x, y;
    for (x = Cnt; x != 0; x--)      // Boucle executée Cnt fois
        {
        for (y = 332; y != 0; y--); // Boucle executée Cnt fois
        }
    }

//&&&&&&&&&&&&&&&&&&&&&&&&&&&&&&&&&&&&&&&&&&&&&&&&&&&&&&&&&&&&&
//------------------ Ecrire sur l'afficheur -------------------
//&&&&&&&&&&&&&&&&&&&&&&&&&&&&&&&&&&&&&&&&&&&&&&&&&&&&&&&&&&&&&
 void LCD(char cVar)            // envoi de l'octet dans le port B
    {
    PORTD = cVar;
    LCD_E = 1;                  // validation de l'octet
    LCD_E = 0;
    Delay_ms (1);
    }

//&&&&&&&&&&&&&&&&&&&&&&&&&&&&&&&&&&&&&&&&&&&&&&&&&&&&&&&&&&&&&
//---------------------- Main Program -------------------------
//&&&&&&&&&&&&&&&&&&&&&&&&&&&&&&&&&&&&&&&&&&&&&&&&&&&&&&&&&&&&&

void main(void)
    {
//------------------ Initialisation du PIC --------------------
    LCD_E = 0;                  // variable validation octet
    LCD_RW = 0;                 // variable écriture
    TRISB = 0;
    TRISC = 0;
    TRISD = 0;
//------------------ Initialisation du LCD --------------------
    Delay_ms (1);
    LCD_RST = 0;                // reset
    LCD_RST = 1;
    LCD(0x3F);                  // lcd allumé
    LCD(0xB8);                  // page 0
    LCD(0xC0);                  // pointe vers 1 ligne afficheur
//-------------------- Partie de Gauche -----------------------
    LCD_RS = 0;
    LCD_CS1 = 1;
    LCD_CS2 = 0;
    Pntr = 0;
    for(x = 0; x <= 7; x ++)
        {
        LCD_RS = 0;             // envoi instruction
        LCD(0x40);              // colonne 0
        LCD(0xB8 + x);          // page ++
        LCD_RS = 1;             // envoi caractère

        for(y = 0; y <= 63; y ++)
            {
            LCD(display[Pntr]);
            Pntr ++;
            }
        }
//-------------------- Partie de droite -----------------------
    LCD_RS = 0;
    LCD_CS1 = 0;
    LCD_CS2 = 1;
    Pntr = 0;
    for(x = 0; x <= 7; x ++)
        {
        LCD_RS = 0;             // envoi instruction
        LCD(0x40);              // colonne 0
        LCD(0xB8 + x);          // page ++
        LCD_RS = 1;             // envoi caractère

        for(y = 0; y <= 63; y ++)
            {
            LCD(display[Pntr]);
            Pntr ++;
            }
        }
//------------------------------------------------------------
    LCD_CS1 = 0;
    LCD_CS2 = 0;

//------------------------------------------------------------
    while (1)
        {
        PORTB = 0x01;
        Delay_ms (200);
        PORTB = 0x00;
        Delay_ms (200);
        }
    }

